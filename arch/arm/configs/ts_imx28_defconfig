## arch/arm/mach-mxs/Kconfig
```kconfig
config SOC_IMX23
	bool
	select ARM_AMBA
	select ARM_CPU_SUSPEND if PM
	select CPU_ARM926T
	select PINCTRL_IMX23

config SOC_IMX28
	bool
	select ARM_AMBA
	select ARM_CPU_SUSPEND if PM
	select CPU_ARM926T
	select PINCTRL_IMX28

config ARCH_MXS
	bool "Freescale MXS (i.MX23, i.MX28) support"
	depends on ARCH_MULTI_V5
	select GPIOLIB
	select MXS_TIMER
	select PINCTRL
	select SOC_BUS
	select SOC_IMX23
	select SOC_IMX28
	select STMP_DEVICE
	help
	  Support for Freescale MXS-based family of processors

config MX28_ENET_ISSUE
	bool "Enable MX28 enet issue fix - Read help!"
	depends on SOC_IMX28
	default y
	help
	  Say Y to enable a fix for link up/down issue on mx28.
	  It is STRONGLY! recommended to always have external oscillators
	  provide the clock to ENET PHY and FEC unit.
```

## drivers/misc/ts-fpga/Kconfig
```kconfig
menu "TS-FPGA devices"

config TS7120_FPGA
	tristate "TS-7120 FPGA Support"
	depends on m
	default n
	help
	  Select this option if you have a Technologic Systems TS-7120 SBC.
	  The driver is necessary if you want to use the devices that are
	  present on that board's FPGA.

	  If unsure, say N.

endmenu
```

## drivers/pc104/Kconfig
```kconfig
#
# PC104 framework configuration
#

menu "PC104 Support"

config PC104
	tristate "PC104 Bus support"
	help
	  Say Y here if you want to support PC104 peripherals

if PC104

config PC104_TSRELAY8
	tristate "TS-RELAY8 Driver"
	help
	  Enables support for the TS-RELAY8 with 8 relays

endif # PC104

endmenu
```
